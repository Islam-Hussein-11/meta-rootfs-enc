## meta-rootfsenc/conf/layer.conf
```bitbake
# We have a conf and classes directory, add to BBPATH
BBPATH .= ":${LAYERDIR}"

# We have recipes-* directories, add to BBFILES
BBFILES += "${LAYERDIR}/recipes-*/*/*.bb \
            ${LAYERDIR}/recipes-*/*/*.bbappend"

BBFILE_COLLECTIONS += "meta-rootfsenc"
BBFILE_PATTERN_meta-rootfsenc = "^${LAYERDIR}/"
BBFILE_PRIORITY_meta-rootfsenc = "6"

LAYERDEPENDS_meta-rootfsenc = "core"
LAYERSERIES_COMPAT_meta-rootfsenc = "scarthgap"
```
